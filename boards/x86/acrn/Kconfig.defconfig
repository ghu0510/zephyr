## boards/x86/acrn/Kconfig.defconfig
```kconfig
# Copyright (c) 2021 Intel Corporation
# SPDX-License-Identifier: Apache-2.0

if BOARD_ACRN

config PIC_DISABLE
	default y

config LOAPIC
	default y

config APIC_TSC_DEADLINE_TIMER
	default y

config X2APIC
	default y

config CONSOLE
	default y

config SERIAL
	default y

config UART_CONSOLE
	default y

config BUILD_OUTPUT_BIN
	default y

config SHELL_BACKEND_SERIAL_INTERRUPT_DRIVEN
	default n

config KERNEL_VM_SIZE
	default 0x1000000

config BUILD_NO_GAP_FILL
	default y

config MP_MAX_NUM_CPUS
	default 2

config ACPI
	default y

config BOARD
	default "acrn"
endif
```

## boards/x86/acrn/acrn_defconfig
```kconfig
# SPDX-License-Identifier: Apache-2.0

CONFIG_SOC_IA32=y
CONFIG_BOARD_ACRN=y
CONFIG_SYS_CLOCK_HW_CYCLES_PER_SEC=25000000
```

## boards/x86/acrn/acrn_rpl_crb_defconfig
```kconfig
# SPDX-License-Identifier: Apache-2.0

CONFIG_SOC_IA32=y
CONFIG_BOARD_ACRN=y
CONFIG_SYS_CLOCK_HW_CYCLES_PER_SEC=1900000000
CONFIG_APIC_TIMER_IRQ_PRIORITY=1
CONFIG_SMP=y
```

## boards/xtensa/intel_adsp_ace15_mtpm/Kconfig.defconfig
```kconfig
# Copyright (c) 2020 Intel Corporation
#
# SPDX-License-Identifier: Apache-2.0

if BOARD_INTEL_ADSP_ACE15_MTPM

config BOARD
	default "intel_adsp_ace15_mtpm"

if DAI_INTEL_SSP

config DAI_SSP_HAS_POWER_CONTROL
	def_bool y

endif

endif # BOARD_INTEL_ADSP_ACE15_MTPM

if BOARD_INTEL_ADSP_ACE15_MTPM_SIM

config BOARD
	default "intel_adsp_ace15_mtpm_sim"

if DAI_INTEL_SSP

config DAI_SSP_HAS_POWER_CONTROL
	def_bool y

endif

endif # BOARD_INTEL_ADSP_ACE15_MTPM_SIM
```

## boards/xtensa/intel_adsp_ace30_ptl/Kconfig.board
```kconfig
# Xtensa board configuration

# Copyright (c) 2022 Intel Corporation
# SPDX-License-Identifier: Apache-2.0

config  BOARD_INTEL_ADSP_ACE30_PTL_SIM
	bool "Intel ADSP ACE 3.0 Panther Lake Simulator"
	depends on SOC_SERIES_INTEL_ACE1X
```

## boards/xtensa/intel_adsp_ace30_ptl/Kconfig.defconfig
```kconfig
# Copyright (c) 2022 Intel Corporation
#
# SPDX-License-Identifier: Apache-2.0

if BOARD_INTEL_ADSP_ACE30_PTL_SIM

config BOARD
	default "intel_adsp_ace30_ptl_sim"


endif # BOARD_INTEL_ADSP_ACE30_PTL_SIM

if BOARD_INTEL_ADSP_ACE30_PTL

config BOARD
	default "intel_adsp_ace30_ptl"

endif # BOARD_INTEL_ADSP_ACE30_PTL
```

## dts/bindings/sensor/zephyr,senss-motion-detector.yaml
```yaml
# Copyright (c) 2022, Intel Corporation
# SPDX-License-Identifier: Apache-2.0
#

description: Sensor subsystem (senss) motion detector sensor bindings.

compatible: "zephyr,senss-motion-detector"

# Common senss sensor properties and underlying device properties.
include: ["zephyr,senss-sensor.yaml"]
```

## dts/bindings/sensor/zephyr,senss-phy-accel.yaml
```yaml
# Copyright (c) 2022, Intel Corporation
# SPDX-License-Identifier: Apache-2.0
#

description: Sensor subsystem (senss) physical accelerometer sensor bindings.

compatible: "zephyr,senss-phy-accel"

include: zephyr,senss-phy-sensor.yaml
```

## dts/bindings/sensor/zephyr,senss-sensor.yaml
```yaml
# Copyright (c) 2022, Intel Corporation
# SPDX-License-Identifier: Apache-2.0
#

description: Sensor subsystem (senss) sensor common properties bindings.

include: sensor-device.yaml

properties:
  sensor-type:
    type: int
    required: true
    description: sensor type id (follow HID spec definition)

  sensor-index:
    type: int
    required: true
    description: sensor instance index for same sensor type

  vendor:
    type: string
    required: true
    description: sensor vendor name

  model:
    type: string
    required: true
    description: sensor model name

  friendly-name:
    required: true

  minimal-interval:
    type: int
    required: true
    description: sensor minimal report interval

  rotation-matrix:
    type: array
    description: sensor rotation matrix

  reporters:
    type: phandles
    description: sensor reporters
```

## samples/subsys/senss/sample.yaml
```yaml
sample:
  description: A sensor framework sample
  name: senss sample
common:
  tags: senss
  integration_platforms:
    - native_posix
  harness: console
  harness_config:
    type: multi_line
    regex:
      - "senss run successfully"
      - "Sensor base-accel data:"
      - "Sensor lid-accel data:"
tests:
  sample.subsys.senss:
    tags: senss
```

## soc/xtensa/intel_adsp/ace/Kconfig.defconfig.ace15_mtpm
```kconfig
# Copyright (c) 2022 Intel Corporation
# SPDX-License-Identifier: Apache-2.0


if SOC_INTEL_ACE15_MTPM

config SOC
	string
	default "intel_ace15_mtpm"

config MP_MAX_NUM_CPUS
	default 3

config SYS_CLOCK_HW_CYCLES_PER_SEC
	default 400000000 if XTENSA_TIMER
	default 1000000 if INTEL_ADSP_SIM
	default 19200000 if INTEL_ADSP_TIMER

config SYS_CLOCK_TICKS_PER_SEC
	default 1000 if INTEL_ADSP_SIM
	default 50000

endif
```

## soc/xtensa/intel_adsp/ace/Kconfig.defconfig.ace20_lnl
```kconfig
# Copyright (c) 2022 Intel Corporation
# SPDX-License-Identifier: Apache-2.0


if SOC_INTEL_ACE20_LNL

config SOC
	string
	default "intel_ace20_lnl"

config MP_MAX_NUM_CPUS
	default 4

config SYS_CLOCK_HW_CYCLES_PER_SEC
	default 400000000 if XTENSA_TIMER
	default 1000000 if INTEL_ADSP_SIM
	default 19200000 if INTEL_ADSP_TIMER

config SYS_CLOCK_TICKS_PER_SEC
	default 1000 if INTEL_ADSP_SIM
	default 50000

endif
```

## soc/xtensa/intel_adsp/ace/Kconfig.defconfig.ace30_ptl
```kconfig
# Copyright (c) 2022 Intel Corporation
# SPDX-License-Identifier: Apache-2.0


if SOC_INTEL_ACE30_PTL

config SOC
	string
	default "intel_ace30_ptl"

config MP_MAX_NUM_CPUS
	default 3

config XTENSA_MMU_WA_NO_PTE_CACHE
	# FIXME: Workaround caching issue
	default y if MMU

config SYS_CLOCK_HW_CYCLES_PER_SEC
	default 400000000 if XTENSA_TIMER
	default 1000000 if INTEL_ADSP_SIM
	default 19200000 if INTEL_ADSP_TIMER

config SYS_CLOCK_TICKS_PER_SEC
	default 1000 if INTEL_ADSP_SIM
	default 50000

endif
```

## subsys/senss/Kconfig
```kconfig
# Copyright (c) 2022 Intel Corporation
# SPDX-License-Identifier: Apache-2.0

config SENSS
	bool "Sensor Subsystem"
	default y
	depends on DT_HAS_ZEPHYR_SENSS_ENABLED
	select RING_BUFFER
	help
	  Enable Sensor Subsystem.

if SENSS

module = SENSS
module-str = senss
source "subsys/logging/Kconfig.template.log_config"

config SENSS_MAX_SENSOR_COUNT
	int "maximum sensor count for senss"
	depends on SENSS
	default 128
	help
	  This is the maximum sensor count supported for senss
	  Typical values are 128

config SENSS_MAX_REPORTER_COUNT
	int "maximum reporters count for an client sensor"
	depends on SENSS
	default 10
	help
	  This is the maximum sensor reporeters count supported for a sensor
	  Typical values are 10

config SENSS_MAX_SENSITIVITY_COUNT
	int "maximum sensitivity count one sensor could support"
	depends on SENSS
	default 6
	help
	  This is the maximum sensitivity count one sensor could support
	  Typical values are 6

config SENSS_MAX_HANDLE_COUNT
	int "maximum handle count"
	depends on SENSS
	default 256
	help
	  This is the maximum handle count senss could support
	  when sensor is opened by applcaiton, senss_open_sensor()
	  is called, handle count will accumulate. Sensor connection will
	  be created for each hanle
	  Typical values are 256

config SENSS_RING_BUF_SIZE
	int "ring buf size to store sensor data"
	depends on SENSS
	default 16384
	help
	  This is the ring buffer to store sensor data that
	  will be posted to application
	  Typical values are 16 * 1024

config SENSS_MAX_SENSOR_DATA_SIZE
	int "maximum sensor data size"
	depends on SENSS
	default 64
	help
	  This is the maximum sensor data size senss could support
	  when sensor is posting data to client, sensor management would
	  get no more than SENSS_MAX_SENSOR_DATA_SIZE sensor count from ring buffer
	  Typical values are 64

config SENSS_RUNTIME_THREAD_STACK_SIZE
	int "stack size for sensor runtime thread"
	depends on SENSS
	default 4096
	help
	  This is the stack size for sensor runtime thread
	  Typical values are 4096

config SENSS_DISPATCH_THREAD_STACK_SIZE
	int "stack size for sensor dispatch thread"
	depends on SENSS
	default 1024
	help
	  This is the stack size for sensor dispatch thread
	  Typical values are 1024

config SENSS_RUNTIME_THREAD_PRIORITY
	int "priority for sensor subsysterm runtime thread"
	depends on SENSS
	default 9
	help
	  This is the thread priority for sensor subsysterm runtime thread
	  Ring buffer data is stored by runtime thread, and then give semaphore
	  to notify dispatch thread, runtime thread priority should lower than
	  dispatch thread priority to ensure dispatch thread could fetch data as
	  soon as runtime thread give semaphore. Take for example, if runtime
	  priority is higher than dispatch thread, and runtime running in full
	  loadering with no sleep, then dispatch thread has no change to fetch
	  data, then ring buf will always be put into data until overflow.
	  Typical values are 9

config SENSS_DISPATCH_THREAD_PRIORITY
	int "priority for sensor dispatch thread"
	depends on SENSS
	default 8
	help
	  This is the thread priority for sensor subsystem dispatch thread
	  Ring buffer data should be fetched ASAP, so Dispatch
	  thread priority should be higher than runtime thread
	  Typical values are 8

source "subsys/senss/sensor/phy_3d_sensor/Kconfig"
source "subsys/senss/sensor/motion_detector/Kconfig"
source "subsys/senss/sensor/hinge_angle/Kconfig"

endif # SENSS
```

## subsys/senss/sensor/motion_detector/Kconfig
```kconfig
# Copyright (c) 2022 Intel Corporation
# SPDX-License-Identifier: Apache-2.0

config  SENSS_SENSOR_MOTION_DETECTOR
	bool "Senss motion detector sensor"
	depends on DT_HAS_ZEPHYR_SENSS_MOTION_DETECTOR_ENABLED
	default y
	help
	  Enable senss motion detector sensor.
```

## subsys/senss/sensor/phy_acc/Kconfig
```kconfig
# Copyright (c) 2022 Intel Corporation
# SPDX-License-Identifier: Apache-2.0

config SENSS_SENSOR_PHY_ACC
	bool "Senss physical accelerometer sensor"
	default y
	depends on DT_HAS_ZEPHYR_SENSS_PHY_ACCEL_ENABLED
	help
	  Enable senss physical accelerometer sensor.
```

## tests/boards/intel_adsp/mmu/testcase.yaml
```yaml
common:
  tags: mmu
tests:
  boards.intel_adsp.mmu:
    platform_allow: intel_adsp_ace30_ptl_sim
```
