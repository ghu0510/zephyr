## CMakeLists.txt
```
# SPDX-License-Identifier: Apache-2.0

cmake_minimum_required(VERSION 3.20.0)

find_package(Zephyr REQUIRED HINTS $ENV{ZEPHYR_BASE})
project(senss)

if (CONFIG_SENSS)
  if (CONFIG_CHRE)
    zephyr_library_sources(
      src/main.cpp
      src/nanoapps/sensor_world.cpp
    )
  endif()
endif()
```

## sample.yaml
```
sample:
  description: A sensor framework sample with chre
  name: senss sample with chre
common:
  tags: senss
  integration_platforms:
    - native_posix
  harness: console
  harness_config:
    type: multi_line
    regex:
      - "senss run successfully"
      - "chre run successfully"
      - "chre sensor nanoapp start successfully"
tests:
  sample.subsys.senss.chre:
    tags: senss
```

## prj.conf
```kconfig
CONFIG_LOG=y
CONFIG_CHRE=y
CONFIG_CHRE_LOG_LEVEL_DBG=y
CONFIG_CHRE_SENSORS_SUPPORT_ENABLED=y
CONFIG_CPP=y
CONFIG_CPP_MAIN=y
CONFIG_STD_CPP17=y
CONFIG_FPU=y
```

## app.overlay
```dts
/*
 * Copyright (c) 2022 Intel Corporation
 *
 * SPDX-License-Identifier: Apache-2.0
 *
 * Names in this file should be chosen in a way that won't conflict
 * with real-world devicetree nodes, to allow these tests to run on
 * (and be extended to test) real hardware.
 */


/ {
	senss: senss-node {
		compatible = "zephyr,senss";
		status = "okay";
	};
};
```

## src/main.cpp
```c
/*
 * Copyright (c) 2022 Intel Corporation.
 *
 * SPDX-License-Identifier: Apache-2.0
 */

#include <zephyr/device.h>
#include <zephyr/devicetree.h>
#include <zephyr/logging/log.h>
#include <zephyr/senss/senss.h>
#include "apps.hpp"
#include "chre/core/event_loop_manager.h"
#include "chre/target_platform/init.h"
#include "chre/util/nanoapp/app_id.h"

#define WAIT_CHRE_RUN_MAX_MS 500

int main(void)
{
	int ret;
	int i;

	ret = senss_init();
	if (ret) {
		LOG_ERR("senss init error");
		return -1;
	}

	LOG_INF("senss run successfully");

	auto sensor_app = chre::initializeStaticNanoappSensorWorld();
	auto& event_loop =
		chre::EventLoopManagerSingleton::get()->getEventLoop();

	if (chre::zephyr::init()) {
		LOG_ERR("chre init error");
		return -1;
	}

	for (i = 0; i < WAIT_CHRE_RUN_MAX_MS; i++) {
		k_msleep(1);
		/* post system event return true means chre is running */
		if (event_loop.postSystemEvent(static_cast<uint16_t>(
			chre::SystemCallbackType::FirstCallbackType), NULL,
			[](uint16_t type, void *data, void *extraData) { },
			NULL)) {
			break;
		}
	}

	if (i == WAIT_CHRE_RUN_MAX_MS) {
		LOG_ERR("chre run timeout, waited %d ms",
			WAIT_CHRE_RUN_MAX_MS);
		return -1;
	}

	LOG_INF("chre run successfully");

	if (!event_loop.startNanoapp(sensor_app)) {
		LOG_ERR("chre sensor nanoapp start error");
		return -1;
	}

	LOG_INF("chre sensor nanoapp start successfully");
	return 0;
}
```

## src/apps.hpp
```c
/* Copyright (c) 2021 Google LLC
 * SPDX-License-Identifier: Apache-2.0
 */

#ifndef SAMPLES_APPLICATION_DEVELOPMENT_CHRE_INCLUDE_APPS_H_
#define SAMPLES_APPLICATION_DEVELOPMENT_CHRE_INCLUDE_APPS_H_

#include "chre/core/nanoapp.h"
#include "chre/util/unique_ptr.h"

namespace chre {

UniquePtr<Nanoapp> initializeStaticNanoappSensorWorld();

}  /* namespace chre */

#endif /* SAMPLES_APPLICATION_DEVELOPMENT_CHRE_INCLUDE_APPS_H_ */
```
